## main/Kconfig.projbuild
```kconfig
menu "NSController Configuration"

    config MCU_DEBUG
        bool "Enable MCU debug logging"
        default n
        help
            Enable detailed debug output for MCU operations.
    
    config SAVE_PAIRING_INFO
        bool "Save pairing information"
        default y
        help
            Save pairing information to flash memory for future use.

    choice TRANSPORT_LAYER_CHOICE
        prompt "Transport Layer"
        default TRANSPORT_LAYER_UART
        help
            Select the physical transport layer for controller communication.

        config TRANSPORT_LAYER_UART
            bool "UART (UART0/CH9102 by default; see CONTROL_UART_*)"
            help
                Use the UART transport. The control plane rides UART0 (the
                CH9102 bridge, where ESP_LOG lives — ADR-0001); the pins and
                baud come from the CONTROL_UART_* options below. Selecting
                UART1/GPIO4-5 for the legacy EasyCon wiring is still possible by
                setting CONTROL_UART_PORT=1 and the two pins to 4 and 5.

        config TRANSPORT_LAYER_USB_SERIAL_JTAG
            bool "USB Serial/JTAG (USB port)"
            help
                Use USB Serial/JTAG controller for communication.
                Device will appear as /dev/ttyACM0 on Linux.
                Note: Ensure console is set to UART0 when using this option.

        config TRANSPORT_LAYER_USB_CDC
            bool "USB CDC (Virtual Serial, ESP32-S3)"
            depends on IDF_TARGET_ESP32S3
            help
                Use USB OTG CDC ACM for communication.
                Device will appear as a virtual serial port (/dev/ttyACM0 on Linux).
                Note: Ensure console is set to UART0 when using this option.
    endchoice

    config TRANSPORT_LAYER
        int
        default 0 if TRANSPORT_LAYER_UART
        default 1 if TRANSPORT_LAYER_USB_SERIAL_JTAG
        default 2 if TRANSPORT_LAYER_USB_CDC

    choice PROTOCOL_LAYER_CHOICE
        prompt "Protocol Layer"
        default PROTOCOL_LAYER_SIMPLE
        help
            Select the protocol layer implementation for the transport layer.

        config PROTOCOL_LAYER_SIMPLE
            bool "Simple protocol layer (default)"

        config PROTOCOL_LAYER_CONTROL
            bool "CONTROL protocol layer (control plane, §2)"
            help
                The NS2 control plane: COBS+CRC framing, HELLO/STATUS and the
                canonical ERROR table. Stages follow docs/spec/12-handoff.md.

        config PROTOCOL_LAYER_EASYCON
            bool "EasyCon protocol layer"
    endchoice

    config PROTOCOL_LAYER
        int
        default 0 if PROTOCOL_LAYER_SIMPLE
        default 1 if PROTOCOL_LAYER_EASYCON
        default 2 if PROTOCOL_LAYER_CONTROL

    config CONTROL_UART_PORT
        int "Control-plane UART port (0 = UART0/CH9102 console)"
        default 0
        range 0 2
        help
            UART0 is the CH9102 bridge the control plane shares with ESP_LOG
            (spec §2.1). Port 1 with pins 4/5 is the legacy EasyCon header.

    config CONTROL_UART_BAUD
        int "Control-plane UART baud rate"
        default 115200
        help
            115200, a bench fact (spec §2.1, G-1 closed by #33): 921600
            degenerates the §2.7 window blast (12-15 window retries per
            4093 B, zero corruption) because the device's bulk drain is
            ~14-20 KiB/s of wire bytes, and 115200 survives every transfer
            to the 65528 B capacity maximum. The measurement is
            docs/research/baud-bench.md.

    config CONTROL_UART_RX_PIN
        int "Control-plane UART RX pin (-1 = chip default)"
        default -1
        range -1 48
        help
            -1 keeps the chip's default IO_MUX pin, which is what UART0's
            CH9102 wiring wants. Set 4 for the legacy UART1/GPIO4 header.

    config CONTROL_UART_TX_PIN
        int "Control-plane UART TX pin (-1 = chip default)"
        default -1
        range -1 48
        help
            -1 keeps the chip's default IO_MUX pin. Set 5 for the legacy
            UART1/GPIO5 header.

    config HID_REPORT_INTERVAL
        int "HID Report Interval (ms)"
        default 15
        range 5 100
        help
            Interval between HID report transmissions in milliseconds.
            Lower values provide lower latency but require more CPU processing.
            For ESP32-C61 (single-core), 20ms is recommended to avoid mbuf allocation failures.

endmenu
```
